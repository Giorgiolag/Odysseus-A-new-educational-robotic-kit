#include <TinyWireM.h>
#include <TinyWireS.h>
// I2C definitions
#define I2C_SDA         PB1                   // serial data pin
#define I2C_SCL         PB3                   // serial clock pin
#define LEFT_LED        PB4
#define I2C_SDA_HIGH()  DDRB &= ~(1<<I2C_SDA) // release SDA   -> pulled HIGH by resistor
#define I2C_SDA_LOW()   DDRB |=  (1<<I2C_SDA) // SDA as output -> pulled LOW  by MCU
#define I2C_SCL_HIGH()  DDRB &= ~(1<<I2C_SCL) // release SCL   -> pulled HIGH by resistor
#define I2C_SCL_LOW()   DDRB |=  (1<<I2C_SCL) // SCL as output -> pulled LOW  by MCU

// OLED definitions

#define OLED_ADDR       0x78        // OLED write address
#define OLED_CMD_MODE   0x00        // set command mode
#define OLED_DAT_MODE   0x40        // set data mode
#define OLED_INIT_LEN   25          // 12: no screen flip, 14: screen flip
#define I2C_SLAVE_ADDRESS 0x01       // Address of the slave
// I2C init function

volatile byte msg = 0, prev_msg = 0,error_msg = 0, OK_msg = 0, connected_msg = 0;
int left_blink = 0;
long left_blink_change_status;
int left_led_blink_status;
int right_blink = 0;
long right_blink_change_status;
int right_led_blink_status;
long connected_message_timer, error_message_timer, OK_message_timer;
int orientation;
uint8_t to_arduino;
void I2C_init(void) {
  DDRB  &= ~((1<<I2C_SDA)|(1<<I2C_SCL));  // pins as input (HIGH-Z) -> lines released
  PORTB &= ~((1<<I2C_SDA)|(1<<I2C_SCL));  // should be LOW when as ouput
}


// OLED init settings
const uint8_t OLED_INIT_CMD[] PROGMEM = {
      0xAE,           //Set display Off
      0xD5, 0x80,     //Set display clock divide ratio/oscillator frequency
      0xA8, 0x3F,     //Set multiplex ratio
      0xD3, 0x00,     //Set display offset
      0x40,           //Set display start line
      0x8D,           //Set charge pump
      0x14,           //VCC generated by internal DC/DC circuit
      0xA1,           //Set segment re-map 
      0xC0,           //Set COM output scan direction
      0xDA, 0x12,     //Set COM pins hardware configuration
      0x81, 0xCF,     //Set contrast control
      0xD9, 0xF1,     //Set pre-changed period
      0xDB, 0x40,     //Set VCOMH Deselected level
      0xA4,           //Set entire display on/off
      0xA6,           //Set normal/inverse display 
      0x20, 0x00,     //Set memory address mode
      0xAF            //Set display on
//  0xA8, 0x3F,       // set multiplex (HEIGHT-1): 0x1F for 128x32, 0x3F for 128x64 
 // 0x22, 0x00, 0x07, // set min and max page
 // 0x20, 0b00,       // set horizontal memory addressing mode
 // 0xDA, 0x02,       // set COM pins hardware configuration to sequential
 // 0x8D, 0x14,       // enable charge pump
//  
//  0xAF,             // switch on OLED
//  0x00,      // Set low nibble of column address
//  0x10,     // Set high nibble of column address
//  0x40,     // Set display start line address

};

// I2C start transmission


void I2C_start(uint8_t addr) {
  I2C_SDA_LOW();                          // start condition: SDA goes LOW first
  I2C_SCL_LOW();                          // start condition: SCL goes LOW second
  I2C_write(addr);                        // send slave address
}

// I2C stop transmission
void I2C_stop(void) {
  I2C_SDA_LOW();                          // prepare SDA for LOW to HIGH transition
  I2C_SCL_HIGH();                         // stop condition: SCL goes HIGH first
  I2C_SDA_HIGH();                         // stop condition: SDA goes HIGH second
}

// I2C transmit one data byte to the slave, ignore ACK bit, no clock stretching allowed
void I2C_write(uint8_t data) {
  for(uint8_t i = 8; i; i--) {            // transmit 8 bits, MSB first
    I2C_SDA_LOW();                        // SDA LOW for now (saves some flash this way)
    if (data & 0x80) I2C_SDA_HIGH();      // SDA HIGH if bit is 1
    I2C_SCL_HIGH();                       // clock HIGH -> slave reads the bit
    data<<=1;                             // shift left data byte, acts also as a delay
    I2C_SCL_LOW();                        // clock LOW again
  }
  I2C_SDA_HIGH();                         // release SDA for ACK bit of slave
  I2C_SCL_HIGH();                         // 9th clock pulse is for the ACK bit
  asm("nop");                             // ACK bit is ignored, just a delay
  I2C_SCL_LOW();                          // clock LOW again
}

// OLED init function
void OLED_init(void) {
  I2C_init();                       // initialize I2C first
  I2C_start(OLED_ADDR);             // start transmission to OLED
  I2C_write(OLED_CMD_MODE);         // set command mode
  for (uint8_t i = 0; i < OLED_INIT_LEN; i++) I2C_write(pgm_read_byte(&OLED_INIT_CMD[i])); // send the command bytes
  I2C_stop();                       // stop transmission
}
void OLED_cursor(uint8_t xpos, uint8_t ypos) {
  I2C_start(OLED_ADDR);             // start transmission to OLED
  I2C_write(OLED_CMD_MODE);         // set command mode
  I2C_write(xpos & 0x0F);           // set low nibble of start column
  I2C_write(0x10 | (xpos >> 4));    // set high nibble of start column
  I2C_write(0xB0 | (ypos & 0x07));  // set start page
  I2C_stop();                       // stop transmission
}

//-------------------------------------------------------------------------

//----------------------------------------------------------------------------

void print2_bitmap(uint8_t bitmap[]) {
  uint8_t bitmap_byte=0;
  uint8_t full_lines;
  uint8_t line_offset;
  uint16_t remaining_num_of_zeros = 0;
  uint16_t i=0;
  uint16_t j=0;
  uint16_t k=-1;
  while (j<1024)
   {
      if (j % 128 == 0)
      {
        I2C_stop();
        OLED_cursor(2, k);
        k++;
        I2C_start(OLED_ADDR);             // start transmission to OLED
        I2C_write(OLED_DAT_MODE);          // set command mode
      }
      if (remaining_num_of_zeros !=0)
      {
         I2C_write(0x00);
         remaining_num_of_zeros--;
         j++;
      }
      else
      {
          bitmap_byte = pgm_read_byte(&bitmap[i]);
          if (bitmap_byte != 0)
          {
            I2C_write(bitmap_byte);
            i++;
            j++;
          }
          else
          {
            full_lines = pgm_read_byte(&bitmap[++i]);
            line_offset = pgm_read_byte(&bitmap[++i]);
            remaining_num_of_zeros = full_lines*128+line_offset;
            i++;     
          }
      }
      
  }
 I2C_stop();
 OLED_cursor(0, 0);
}

//-------------------------------------------------------------------------
void  OLED_setRotation(uint8_t rotation) {
  uint8_t rotationBit = (rotation & 0x01);
  I2C_start(OLED_ADDR);             // start transmission to OLED
  I2C_write(OLED_CMD_MODE);         // set command mode
  I2C_write(0xC0 | (rotationBit << 3));
  I2C_write(0xA0 | rotationBit);
  I2C_stop();
}

 //----------------------------------------------------------------------- 
#include <Tiny4kOLED.h>
const uint8_t oddyseas[] PROGMEM = {0, 2, 42, 248, 248, 248, 248, 248, 248, 248, 248, 0, 0,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 2, 52};

const uint8_t empty_screen[] PROGMEM ={0,8,0};

const uint8_t ungry[] PROGMEM ={0, 1, 46, 32, 64, 128, 0, 0, 27, 128, 64, 32, 0,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 2, 50};

const uint8_t smile[] PROGMEM ={0, 2, 42, 248, 248, 248, 248, 248, 248, 248, 248, 0, 0,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 2, 51};

const uint8_t front_arrow[] PROGMEM ={0, 1, 57, 128, 192, 224, 240, 248, 252, 254, 255, 254, 252,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 1, 61};

const uint8_t back_arrow[] PROGMEM ={0, 1, 62, 240, 240, 240, 240, 240, 0, 0, 123, 255, 255,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 1, 59};

const uint8_t left_arrow[] PROGMEM ={0, 2, 36, 128, 192, 224, 240, 0, 0, 117, 64, 224, 240,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 2, 88};

const uint8_t right_arrow[] PROGMEM ={0, 2, 88, 240, 224, 192, 128, 0, 0, 66, 240, 240, 240,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 2, 39};

const uint8_t OK[] PROGMEM ={0, 1, 81, 128, 224, 240, 252, 254, 255, 127, 31, 14, 0,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 1, 65};

const uint8_t winging[] PROGMEM ={0, 2, 42, 248, 248, 248, 248, 248, 248, 248, 248, 0, 0,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 1, 51};

const uint8_t in_love[]PROGMEM ={0, 1, 35, 128, 224, 240, 240, 248, 248, 248, 240, 224, 192,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 2, 51};

const uint8_t under_construction[]PROGMEM ={0, 1, 31, 254, 254, 254, 14, 14, 14, 14, 14, 14, 14,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 0, 13};

const uint8_t program_deleted[]PROGMEM = {0, 1, 41, 224, 224, 96, 32, 32, 32, 96, 224, 224, 224,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 1, 43};

const uint8_t obstacle_detected[]PROGMEM ={0, 1, 34, 56, 126, 254, 255, 239, 255, 254, 126, 60, 0,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 1, 35};

const uint8_t color_detected[]PROGMEM ={0, 1, 31, 224, 160, 96, 160, 96, 160, 96, 160, 96, 160,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 0, 65};

const uint8_t not_connected[]PROGMEM = {0, 1, 48, 128, 128, 128, 128, 0, 0, 16, 128, 128, 128,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 2, 58};

const uint8_t connected_to_pc[]PROGMEM = {0, 2, 19, 128, 192, 224, 224, 240, 240, 248, 248, 248, 248,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 3, 24};

const uint8_t oops[]PROGMEM = {0, 2, 31, 128, 192, 64, 64, 64, 64, 64, 192, 128, 0,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 1, 67};

const uint8_t waiting[]PROGMEM = {0, 0, 45, 7, 31, 127, 255, 207, 143, 15, 15, 15, 15,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 0, 54};

const uint8_t waiting_2[]PROGMEM = {0, 1, 53, 128, 128, 128, 192, 192, 192, 192, 192, 192, 192,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 2, 57};


void requestISR() 
{
     TinyWireS.write(to_arduino);
}
void setup()
{
   OLED_init();
   orientation = 1;
   // initialize the OLED
   OLED_setRotation(orientation);
   TinyWireS.begin(I2C_SLAVE_ADDRESS); // join i2c network
   TinyWireS.onRequest(requestISR);                                                                    
   pinMode(PB4, OUTPUT);
   pinMode(PB5, OUTPUT);
   print2_bitmap(not_connected);
   to_arduino = 0;
}

void loop()
{
  if(TinyWireS.available())
  {
    msg=TinyWireS.read();
    if(msg == 2)
       print2_bitmap(empty_screen);
    else if(msg == 3)
       print2_bitmap(oddyseas);
    else if (msg == 4)
       print2_bitmap(ungry);
    else if (msg == 5)
       print2_bitmap(smile);
    else if (msg == 6)
       print2_bitmap(in_love);
    else if (msg == 7)
       print2_bitmap(winging);
    else if (msg == 8)
       print2_bitmap(front_arrow);
    else if (msg == 9)
       print2_bitmap(back_arrow);
    else if (msg == 10)
       print2_bitmap(left_arrow);
    else if (msg == 11)
       print2_bitmap(right_arrow);
    else if (msg == 12)
       print2_bitmap(OK);
    else if (msg == 13)
       print2_bitmap(under_construction); 
    else if (msg == 14)
       print2_bitmap(program_deleted);     
    else if (msg == 15)
    {  digitalWrite(PB4,0);
       left_blink = 0;}
    else if (msg == 16)
    {  digitalWrite(PB4,1);
       left_blink = 0;}
    else if (msg == 17)
    {
      left_blink = 1;
      left_blink_change_status = 0;
      if (left_led_blink_status == 0){
      digitalWrite(PB4,1);
      left_led_blink_status = 1;
      }   
    }
    else if (msg == 18){
      digitalWrite(PB5,0);
      right_blink = 0;}
    else if (msg == 19){
      digitalWrite(PB5,1);
      right_blink = 0;}
    else if (msg == 20)
    {
      right_blink = 1;
      right_blink_change_status = 0;
      if (right_led_blink_status == 0){
      digitalWrite(PB5,1);
      right_led_blink_status = 1;
      }   
    }
    else if (msg == 21)
       print2_bitmap(obstacle_detected); 
    else if (msg == 22)
       print2_bitmap(color_detected);
    else if(msg == 23)
    {
       to_arduino = 0;
       print2_bitmap(not_connected); 
    }
    else if(msg == 24)
    {
       to_arduino = 2;
       print2_bitmap(connected_to_pc);
    }
    
    else if(msg == 25)
    {
      print2_bitmap(oops);
    }  
    else if (msg == 26)
    {
      print2_bitmap(OK);
    } 
    else if (msg == 27)
    {
      if (orientation == 1)
      {
        orientation = 0;
        OLED_setRotation(orientation);
     //   TinyWireS.begin(I2C_SLAVE_ADDRESS);
        print2_bitmap(oddyseas);
      }
      else
      {
        orientation = 1;
        OLED_setRotation(orientation);
     //   TinyWireS.begin(I2C_SLAVE_ADDRESS);
        print2_bitmap(oddyseas);
      }  
    } 
    else if (msg == 28)
      {
        // TinyWireS.write(1);
        // TinyWireS.write(to_arduino);
      }
      else if (msg == 29)
      {
        to_arduino = 1;
        print2_bitmap(waiting);
      }
      
  }
   TinyWireS_stop_check();
  if (left_blink == 1)
  {
    left_blink_change_status = left_blink_change_status+1;
    if (left_blink_change_status >=7000)
    {
      if (left_led_blink_status == 0)
      {
         digitalWrite(PB4,1);
        left_led_blink_status = 1;
        left_blink_change_status = 0;
      }
      else
      {
        digitalWrite(PB4,0);
        left_led_blink_status = 0;
        left_blink_change_status = 0;
      }
    }
  }
   if (right_blink == 1)
  {
    right_blink_change_status = right_blink_change_status+1;
    if (right_blink_change_status >=7000)
    {
      if (right_led_blink_status == 0)
      {
         digitalWrite(PB5,1);
        right_led_blink_status = 1;
        right_blink_change_status = 0;
      }
      else
      {
        digitalWrite(PB5,0);
        right_led_blink_status = 0;
        right_blink_change_status = 0;
      }
    }
  }
}
  
  
